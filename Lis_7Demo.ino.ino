//==================================================
// リサージュ図形デモ
// Ver1.10
//
// Arduino UNO
// SSD1315 OLED 128x64
// U8g2ライブラリ
//
// 10秒ごとに7種のリサージュパターンを自動切替
//==================================================

#include <Arduino.h>
#include <U8g2lib.h>
#include <Wire.h>
#include <math.h>

//--------------------------------------------------
// OLED
//--------------------------------------------------
// 実機はSSD1315だが、U8g2ではSSD1312ドライバを使用
//--------------------------------------------------

U8G2_SSD1312_128X64_NONAME_F_HW_I2C
  u8g2(U8G2_R0, U8X8_PIN_NONE);


//--------------------------------------------------
// 画面サイズ
//--------------------------------------------------

const int CX = 64;
const int CY = 32;

const int RX = 61;
const int RY = 29;


//--------------------------------------------------
// アニメーション
//--------------------------------------------------

float phase = 0.0;

const unsigned long PATTERN_TIME = 10000;

unsigned long patternStart = 0;

int pattern = 0;

const int PATTERN_COUNT = 7;


//--------------------------------------------------
// 描画点数
//--------------------------------------------------

const int POINTS = 180;


//==================================================
// setup
//==================================================

void setup() {

  u8g2.begin();

  patternStart = millis();
}


//==================================================
// loop
//==================================================

void loop() {

  //------------------------------------------------
  // 10秒ごとにパターン変更
  //------------------------------------------------

  if (millis() - patternStart >= PATTERN_TIME) {

    pattern++;

    if (pattern >= PATTERN_COUNT) {
      pattern = 0;
    }

    patternStart = millis();
  }


  //------------------------------------------------
  // OLEDバッファをクリア
  //------------------------------------------------

  u8g2.clearBuffer();


  //------------------------------------------------
  // リサージュ描画
  //------------------------------------------------

  int px = 0;
  int py = 0;

  for (int i = 0; i <= POINTS; i++) {

    float t = TWO_PI * i / POINTS;

    float x;
    float y;


    //------------------------------------------------
    // パターン選択
    //------------------------------------------------

    switch (pattern) {


      //------------------------------------------------
      // 0 : 8の字
      //------------------------------------------------

      case 0:

        x = sin(t);

        y = sin(2.0 * t + phase);

        break;


      //------------------------------------------------
      // 1 : 楕円
      //------------------------------------------------

      case 1:

        x = sin(t);

        y = 0.65 * sin(t + phase);

        break;


      //------------------------------------------------
      // 2 : 円
      //------------------------------------------------

      case 2:

        x = sin(t);

        y = sin(t + phase);

        break;


      //------------------------------------------------
      // 3 : 3:2
      //------------------------------------------------

      case 3:

        x = sin(3.0 * t);

        y = sin(2.0 * t + phase);

        break;


      //------------------------------------------------
      // 4 : 4:3
      //------------------------------------------------

      case 4:

        x = sin(4.0 * t);

        y = sin(3.0 * t + phase);

        break;


      //------------------------------------------------
      // 5 : 5:4
      //------------------------------------------------

      case 5:

        x = sin(5.0 * t);

        y = sin(4.0 * t + phase);

        break;


      //------------------------------------------------
      // 6 : 花形
      //------------------------------------------------

      case 6:

        x = sin(5.0 * t);

        y = sin(6.0 * t + phase);

        break;
    }


    //------------------------------------------------
    // OLED座標へ変換
    //------------------------------------------------

    int sx = CX + x * RX;
    int sy = CY + y * RY;


    //------------------------------------------------
    // 線を描く
    //------------------------------------------------

    if (i > 0) {

      u8g2.drawLine(
        px,
        py,
        sx,
        sy
      );
    }


    px = sx;
    py = sy;
  }


  //------------------------------------------------
  // OLEDへ転送
  //------------------------------------------------

  u8g2.sendBuffer();


  //------------------------------------------------
  // 位相を進める
  //------------------------------------------------

  phase += 0.20;


  //------------------------------------------------
  // 表示速度
  //------------------------------------------------

  delay(25);
}